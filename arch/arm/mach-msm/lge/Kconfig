## arch/arm/mach-msm/lge/Kconfig
```kconfig
config MACH_LGE
	bool

menu "LGE Device-Specific Changes"

menu "LGE Board Selection"

config MACH_MSM7X27_THUNDERG
	depends on ARCH_MSM7X27
	depends on !MSM_STACKED_MEMORY
	select MACH_LGE
	bool "MSM7x27 THUNDER Global"
	help
	  Support for the LGE MSM7x27 THUNDER Global board.

config MACH_MSM7X27_GELATO
    depends on ARCH_MSM7X27
    depends on !MSM_STACKED_MEMORY
    select MACH_LGE
    bool "MSM7x27 GELATO Global"
    help
      Support for the LGE MSM7x27 GELATO Global board.

config MACH_MSM7X27_UNIVA
    depends on ARCH_MSM7X27
    depends on !MSM_STACKED_MEMORY
    select MACH_LGE
    bool "MSM7x27 UNIVA Global"
    help
      Support for the LGE MSM7x27 UNIVA Global board.

config MACH_MSM7X27_MUSCAT
    depends on ARCH_MSM7X27
    depends on !MSM_STACKED_MEMORY
    select MACH_LGE
    bool "MSM7x27 MUSCAT"
    help
      Support for the LGE MSM7x27 MUSCAT board.

config MACH_MSM7X27_JUMP
    depends on ARCH_MSM7X27
    depends on !MSM_STACKED_MEMORY
    select MACH_LGE
    bool "MSM7x27 JUMP"
    help
      Support for the LGE MSM7x27 JUMP board.

config MACH_MSM7X27_ALESSI
    depends on ARCH_MSM7X27
    depends on !MSM_STACKED_MEMORY
    select MACH_LGE
    bool "MSM7x27 ALESSI Global"
    help
       Support for the LGE MSM7x27 ALESSI Global board.        

endmenu

config LGE_SUPPORT_ERS
	tristate "Support LGE ERS system"
	default n
	depends on MACH_LGE
	depends on ANDROID_RAM_CONSOLE
	help
	  LGE error reporting system

config LGE_HANDLE_MODEM_CRASH
	tristate "Support LGE Modem Crash Handler"
	default n
	depends on MACH_LGE
	depends on ANDROID_RAM_CONSOLE
	help
	  LGE modem crash handler

config LGE_HANDLE_PANIC
	tristate "Support LGE Kernel Panic Handler"
	default n
	depends on MACH_LGE
	depends on ANDROID_RAM_CONSOLE
	help
	  LGE kernel panic handler

config LGE_SUPPORT_RAPI
	tristate "Support LGE RAPI"
	default n
	depends on MACH_LGE
	help
	  LGE remote api functions

config LGE_DIAGTEST
	tristate "Support LGE diag test mode"
	default n
	depends on MACH_LGE
	select LGE_SUPPORT_RAPI
	help
	  LGE diag test mode

config LGE_MTD_DIRECT_ACCESS
	tristate "Support LGE mtd direct access apis"
	default n
	depends on MACH_LGE
	help
	  LGE mtd direct access apis

config LGE_HEADSET
	bool

config LGE_HEADSET_ADC
	tristate "LGE GPIO 2 Wire detection driver using ADC"
	default n
	depends on MACH_LGE
	select LGE_HEADSET
	help
	  LGE GPIO 2 Wire detection driver

config LGE_HEADSET_2GPIO
	tristate "LGE GPIO 2 Wire detection driver using 2 GPIO"
	default n
	depends on MACH_LGE
	select LGE_HEADSET
	help
	  LGE GPIO 2 Wire detection driver by using 2 GPIO

config LGE_SWITCH_GPIO
	tristate "LGE GPIO switch driver"
	depends on MACH_LGE
	default n
	help
	  LGE GPIO switch driver 

config LGE_PROC_COMM
	bool "LGE added proc comm"
	depends on MACH_LGE
	default n
	help
	  LGE added proc_comm

config LGE_FUEL_GAUGE
	bool "LGE fuel gauge"
	depends on MACH_LGE
	default n
	help
	  This feature support fuel gauge for msm7K hw

config LGE_UNIFIED_LED
	tristate "LGE unified LED driver"
	depends on MACH_LGE
	default n
	help
	  LGE unified LED driver

config LGE_4G_DDR
	bool "Memory Configuration - 2G/4G DDR RAM "
	depends on MACH_LGE
	default n
	help
	  This patch is used to configure type of Memory
	  Aloha Global use Hynix 4G DDR RAM

config LGE_SUPPORT_AT_CMD
	bool "Support LGE AT_CMD system"
	default n
	depends on MACH_LGE
	help
	 LGE AT_CMD Support

config LGE_ATS_UEVENT_DEVICE
	bool "Support LGE ATS uevent device"
	default n
	depends on MACH_LGE
	help
	 Choose if use ATS_UEVENT device used for sending uevent to user space

config LGE_ATS_INPUT_DEVICE
	bool "Support LGE ATS input device"
	default n
	depends on MACH_LGE
	help
	 Choose if use ATS input device used for generating input event from user space

config LGE_FBCON_INACTIVE_CONSOLE
	bool "Support LGE FBCON inactive console"
	default n
	depends on MACH_LGE
	help
	 Choose if inactive console

config LGE_PWRSINK
	bool "Support LGE Power Sink Driver"
	default n
	depends on MACH_LGE
	help
	 Choose if use Power sink driver

config LGE_HIDDEN_RESET_PATCH
   bool "Hidden reset function"
   default n
   help
     This patch supports hidden reset when kernel panic is occured.
menu "LGE specific patches"
	depends on MACH_LGE

config LGE_TCP_IMPROVEMENT_PATCH
	bool "tcp improvement patch for vs740"
	default n
	help
	  This patch is used to improve tcp performance of vs740 model
	  Disable tcp delayed ack for evdo networks

config LGE_UMS_WORKAROUND_PATCH
	bool "Workaround patch about USB mass storage for vs740"
	default n
	help
	  This patch is used to workaround UMS not working problem of vs740
	  Vs740 had UMS not working problem after composition switching
	  this patch prevents the binding until mass storage thread is killed

config LGE_UMS_PERFORMANCE_PATCH
	bool "Increasing UMS R/W performance patch"
	default n
	help
	  This patch is QCT's patch code for increasing UMS R/W Performance
	  It change maximum interrupt interval from 8 micro-frame to immediate

config LGE_AUDIO_HIDDEN_MENU_TEST_PATCH
	bool "LGE audio hidden menu test patch for vs740"
	default n
	help
	  LGE audio hidden menu test patch for vs740

config LGE_CAMERA_HIDDEN_MENU_TEST_PATCH
	bool "LGE camera hidden menu test patch for vs740"
	default n
	help
	  LGE camera hidden menu test patch for vs740

config LGE_YAFFS_AUTO_CHECKPOINT_PATCH
	bool "LGE yaffs auto checkpoint patch"
	default n
	help
	  set value of yaffs_auto_checkpoint to 2. this patch can decreases 
	  mount time due to scanning all blocks of yaffs partition

config LGE_BRCM_H4_LPM_SUPPORT_PATCH
	bool "LGE brcm's bluetooth lpm patch"
	default n
	help
	  Support brcm's bluetooth LPM requirement

config LGE_MMC_CLEANUP_PATCH
	bool "LGE mmc queue cleanup patch"
	default n
	help
	  This patch is added for prevent kernel panic in case of doing
	  insert/eject repeatedly. this patch are from 2.6.32 mainstream
	  kernel

config LGE_DETECT_PIF_PATCH
	bool "LGE PIF detection capability patch"
	select LGE_PROC_COMM 
	default n
	help
	  This patch is added for detection of pif cable of factory
	  If pif is once detected, that information will be passed through
	  sysfs in battery driver
config LGE_DIAG_WMC
	bool "Support LGE diag WMC"
	default n
	depends on LGE_DIAGTEST
	help
	  LGE diag WMC enable

config LGE_GRAM_REFRESH_PATCH
	bool "LGE gram refresh patch"
	default n
	help
	  This patch is added for gram-embedded device like mddi.
	  because, when suspend state, power of mddi is off usually,
	  gram of DDI chip has garbage data until data of gram is refreshed.
	  this can cause displaying broken screen in time of turning backlight on.
	  for preventing this problem, add refreshing routine before turning 
	  backlight on by using late resume mechanism.

config LGE_FACTORY_PATCH
	bool "LGE workaround patch for factory process"
	default n
	help
	  This patch is added for factory process in PV event
	  This supports Calibration process and user factory reset

config LGE_BLUE_ERROR_HANDLER
	bool "LGE Blue error handler"
	default n
	help
	  This feature support crash handler used thunderg
endmenu

endmenu
```

## arch/arm/mach-msm/lge/Kconfig.board
```kconfig
config MACH_MSM7X27_THUNDERC
	depends on ARCH_MSM7X27
	depends on !MSM_STACKED_MEMORY
	select MACH_LGE
	bool "MSM7x27 THUNDER Verizone"
	help
	  Support for the LGE MSM7x27 THUNDER Verizone board.

config MACH_MSM7X27_THUNDERG
	depends on ARCH_MSM7X27
	depends on !MSM_STACKED_MEMORY
	select MACH_LGE
	bool "MSM7x27 THUNDER Global"
	help
	  Support for the LGE MSM7x27 THUNDER Global board.
```

## drivers/char/diag/Kconfig
```kconfig
menu "Diag Support"

config DIAG_CHAR
	tristate "char driver interface and diag forwarding to/from modem"
	default m
	depends on USB_ANDROID_DIAG || USB_FUNCTION_DIAG
	depends on ARCH_MSM
	help
	 Char driver interface for diag user space and diag-forwarding to modem ARM and back.
endmenu

menu "Modem less Diag Support"

config DIAG_NO_MODEM
	bool "Enable DIAG even when no modem is present"
	depends on USB_ANDROID_DIAG || USB_FUNCTION_DIAG
	depends on ARCH_MSM
	default n
	help
	 This enables DIAG support even when no modem is present.
endmenu
```

## drivers/input/sensor/Kconfig
```kconfig
#
# Sensor driver configuration
#
menuconfig INPUT_SENSOR
	bool "Sensors"
	help
	  Say Y here, and a list of supported touchscreens will be displayed.
	  This option doesn't affect the kernel.

	  If unsure, say Y.

if INPUT_SENSOR

config SENSOR_GP2AP
	tristate "GP2AP based proximity sensor"
	help
	  Say Y here if you have a sensor interface using the
	  GP2AP controller, and your board-specific
	  setup code includes i2c devices.

	  If unsure, say N (but it's safe to say "Y").

	  To compile this driver as a module, choose M here: the
	  module will be called ads7846.

config SENSOR_BMA150
	tristate "BMA150 based accelerometer sensor"
	help
	  Say Y here if you have a sensor interface using the
	  BMA150 controller, and your board-specific
	  setup code includes i2c devices.

	  If unsure, say N (but it's safe to say "Y").

	  To compile this driver as a module, choose M here: the
	  module will be called ads7846.

config SENSOR_BMA250
	tristate "BMA250 based accelerometer sensor"
	help
	  Say Y here if you have a sensor interface using the
	  BMA250 controller, and your board-specific
	  setup code includes i2c devices.

	  If unsure, say N (but it's safe to say "Y").

	  To compile this driver as a module, choose M here: the
	  module will be called bma250.

config SENSOR_K3DH
	tristate "K3DH based accelerometer sensor"
	help
	  Say Y here if you have a sensor interface using the
	  KR3DH controller, and your board-specific
	  setup code includes i2c devices.

	  If unsure, say N (but it's safe to say "Y").

	  To compile this driver as a module, choose M here: the
	  module will be called ads7846.

config SENSOR_KR3DH
	tristate "KR3DH based accelerometer sensor"
	help
	  Say Y here if you have a sensor interface using the
	  KR3DH controller, and your board-specific
	  setup code includes i2c devices.

	  If unsure, say N (but it's safe to say "Y").

	  To compile this driver as a module, choose M here: the
	  module will be called ads7846.

config SENSOR_KR3DM
	tristate "8bit accel data for KR3DM"
	help
	  Say Y here if you have a sensor interface using the
	  KR3DM controller, and your board-specific
	  setup code includes i2c devices.

	  If unsure, say N (but it's safe to say "Y").
	  
config SENSOR_AK8973
	tristate "AK8973 based ecompass sensor"
	help
	  Say Y here if you have a sensor interface using the
	  AK8973 controller, and your board-specific
	  setup code includes i2c devices.

	  If unsure, say N (but it's safe to say "Y").

	  To compile this driver as a module, choose M here: the
	  module will be called ads7846.

config SENSOR_AMI602
        tristate "AMI602 based gyro sensor"
        help
          Say Y here if you have a sensor interface using the
          GP2AP controller, and your board-specific
          setup code includes i2c devices.

          If unsure, say N (but it's safe to say "Y").

          To compile this driver as a module, choose M here: the
          module will be called ads7846.

config SENSOR_AMI304
        tristate "AMI304 based gyro sensor"
        help
          Say Y here if you have a sensor interface using the
          AMI304 controller, and your board-specific
          setup code includes i2c devices.

          If unsure, say N (but it's safe to say "Y").          

config SENSOR_APDS9190
	bool "APDS-9190 based proximity sensor"
	help
	  Say Y here if you have a sensor interface using the
	  APDS-9900 controller, and your board-specific
	  setup code includes i2c devices.

	  If unsure, say N (but it's safe to say "Y").

endif
```

## drivers/net/wireless/bcm4325/Kconfig
```kconfig
config BCM4325
	tristate "Broadcom BCM4325 wireless support"
	select WIRELESS_EXT
	select WEXT_PRIV
	---help---
	  This is a driver for the Broadcom 4325 wireless chip.

config BCM4325_DEBUG
	bool "Debug"
	default n
	depends on BCM4325

config LGE_BCM432X_PATCH
	bool "BCM432X Patch by LGE"
	default y
	depends on BCM4325

config BCM4325_GPIO_BT_RESET
	int "GPIO BT_RESET"
	default 123
	depends on BCM4325

config BCM4325_GPIO_WL_RESET
	int "GPIO WL_RESET"
	default 93
	depends on BCM4325

config BCM4325_GPIO_WL_WAKE
	int "GPIO WL_WAKE"
	default 153
	depends on BCM4325

config BCM4325_GPIO_WL_REGON
	int "GPIO WL_REGON"
	default 23
	depends on BCM4325

config BRCM_LGE_WL_HOSTWAKEUP
	bool "Support BCM4325/BCM4329 Host Wakeup function"
	default 94
	depends on BCM4325

config BRCM_LGE_WL_HOSTWAKEUP_IOCTL
	bool "Use Host Wakeup ioctl function"
	default n
	depends on BCM4325 && BRCM_LGE_WL_HOSTWAKEUP

config BRCM_LGE_WL_PKTFILTER
	bool "Setting Multicat/Broadcast packet fillter."
	default n
	depends on BCM4325 && BRCM_LGE_WL_HOSTWAKEUP

config BRCM_LGE_WL_ARPOFFLOAD
	bool "Use Arp offload function."
	default n
	depends on BCM4325 && BRCM_LGE_WL_HOSTWAKEUP

config BRCM_GPIO_INTR
	bool "Use Broadcom Host Wakeup GPIO"
	default n
	depends on BCM4325
	---help---
	   This function is activated only if set CONFIG_HAS_EARLYSUSPEND.	

config BCM4325_GPIO_WL_HOSTWAKEUP
	int "GPIO WL_HOSTWAKEUP"
	default 94
	depends on BCM4325

config BRCM_USE_DEEPSLEEP
	bool "Use deepsleep instead of dhd_dev_reset"
	default n
	depends on BCM4325
	---help---
	  Use deepsleep instead of dhd_dev_reset and controlling GPIO when driver start or stop.

config BRCM_USE_SOFTAP
	bool "Use SoftAP"
	default n
	depends on BCM4325
	---help---
	Using Softap feature.

config BRCM_USE_STATIC_BUF
	bool "Use static buff of osl_malloc"
	default n
	depends on BCM4325
```

## drivers/net/wireless/bcm4330/Kconfig
```kconfig
config BCM4330
	tristate "Broadcom BCM4330 wireless support"
	select WEXT_PRIV
	select WIRELESS_EXT
	---help---
	  This is a driver for the Broadcom BCM4330 wireless chip.

config BCM4330_DEBUG
	bool "Debug"
	default n
	depends on BCM4330

config LGE_BCM432X_PATCH
	bool "BCM432X Patch by LGE"
	default y
	depends on BCM4330

config BCM4330_GPIO_BT_RESET
	int "GPIO BT_RESET"
	default 123
	depends on BCM4330

config BCM4330_GPIO_WL_RESET
	int "GPIO WL_RESET"
	default 93
	depends on BCM4330

config BCM4330_GPIO_WL_WAKE
	int "GPIO WL_WAKE"
	default 122
	depends on BCM4330

config BCM4330_GPIO_WL_REGON
	int "GPIO WL_REGON"
	default 23
	depends on BCM4330

config BRCM_LGE_WL_HOSTWAKEUP
	bool "Support BCM4325/BCM4329/BCM4330 Host Wakeup function"
	default 94
	depends on BCM4330

config BRCM_LGE_WL_HOSTWAKEUP_IOCTL
	bool "Use Host Wakeup ioctl function"
	default n
	depends on BCM4330 && BRCM_LGE_WL_HOSTWAKEUP

config BRCM_LGE_WL_PKTFILTER
	bool "Setting Multicat/Broadcast packet fillter."
	default n
	depends on BCM4330 && BRCM_LGE_WL_HOSTWAKEUP

config BRCM_LGE_WL_ARPOFFLOAD
	bool "Use Arp offload function."
	default n
	depends on BCM4330 && BRCM_LGE_WL_HOSTWAKEUP

config BRCM_GPIO_INTR
	bool "Use Broadcom Host Wakeup GPIO"
	default n
	depends on BCM4330
	---help---
	   This function is activated only if set CONFIG_HAS_EARLYSUSPEND.	

config BCM4330_GPIO_WL_HOSTWAKEUP
	int "GPIO WL_HOSTWAKEUP"
	default 94
	depends on BCM4330

config BRCM_USE_DEEPSLEEP
	bool "Use deepsleep instead of dhd_dev_reset"
	default n
	depends on BCM4330
	---help---
	  Use deepsleep instead of dhd_dev_reset and controlling GPIO when driver start or stop.

config BRCM_USE_SOFTAP
	bool "Use SoftAP"
	default n
	depends on BCM4330
	---help---
	Using Softap feature.

config BRCM_USE_STATIC_BUF
	bool "Use static buff of osl_malloc"
	default n
	depends on BCM4330

config BRCM_USE_WLP2P
	bool "Use P2P"
	default n
	depends on BCM4330
	---help---
	Using P2P feature.
```
